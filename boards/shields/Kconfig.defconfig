## boards/shields/Kconfig.defconfig
```kconfig
// Kconfig.defconfig
if SHIELD_DAEDALUS_RIGHT

config ZMK_DAEDALUS
    default "Daedalus"

config ZMK_SPLIT_ROLE_CENTRAL
    default y

endif

if SHIELD_DAEDALUS_RIGHT || SHIELD_DAEDALUS_LEFT

config ZMK_SPLIT
    default y

endif
```

## boards/shields/daedalus/Kconfig.defconfig
```kconfig
if SHIELD_DAEDALUS_RIGHT

config ZMK_KEYBOARD_NAME
    default "Daedalus"

config ZMK_SPLIT_ROLE_CENTRAL
    default y

config ZMK_POINTING
    default y

config I2C
    default y

endif

if SHIELD_DAEDALUS_RIGHT || SHIELD_DAEDALUS_LEFT

config ZMK_SPLIT
    default y

endif
```

## config/boards/shields/Kconfig.shield
```kconfig
config SHIELD_DAEDALUS_LEFT
    def_bool $(shields_list_contains,daedalus_left)

config SHIELD_DAEDALUS_RIGHT
    def_bool $(shields_list_contains,daedalus_right)
```

## config/west.yml
```yaml
manifest:
  remotes:
    - name: zmkfirmware
      url-base: https://github.com/zmkfirmware
    - name: Perseus333
      url-base: https://github.com/Perseus333
    # Additional modules containing boards/shields/custom code can be listed here as well
    # See https://docs.zephyrproject.org/3.2.0/develop/west/manifest.html#projects
  projects:
    - name: zmk
      remote: zmkfirmware
      revision: main
      import: app/west.yml
    - name: zmk-keyboards-daedalus
      remote: Perseus333
      revision: master
  self:
    path: config
```
